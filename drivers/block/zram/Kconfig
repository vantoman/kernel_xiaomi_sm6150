## drivers/block/zram/Kconfig
```kconfig
# SPDX-License-Identifier: GPL-2.0
config ZRAM
	tristate "Compressed RAM block device support"
	depends on BLOCK && SYSFS && CRYPTO
	select CRYPTO_LZO
	select ZPOOL
	default n
	help
	  Creates virtual block devices called /dev/zramX (X = 0, 1, ...).
	  Pages written to these disks are compressed and stored in memory
	  itself. These disks allow very fast I/O and compression provides
	  good amounts of memory savings.

	  It has several use cases, for example: /tmp storage, use as swap
	  disks and maybe many more.

	  See Documentation/blockdev/zram.txt for more information.

config ZRAM_WRITEBACK
       bool "Write back incompressible or idle page to backing device"
       depends on ZRAM
       default n
       help
	 With incompressible page, there is no memory saving to keep it
	 in memory. Instead, write it out to backing device.
	 For this feature, admin should set up backing device via
	 /sys/block/zramX/backing_dev.

	 With /sys/block/zramX/{idle,writeback}, application could ask
	 idle page's writeback to the backing device to save in memory.

	 See Documentation/blockdev/zram.txt for more information.

config ZRAM_MEMORY_TRACKING
	bool "Track zRam block status"
	depends on ZRAM && DEBUG_FS
	help
	  With this feature, admin can track the state of allocated blocks
	  of zRAM. Admin could see the information via
	  /sys/kernel/debug/zram/zramX/block_state.

	  See Documentation/blockdev/zram.txt for more information.

config ZRAM_DEFAULT_COMP_ALGORITHM
	string "Default ZRAM compression algorithm"
	default "lzo"

choice
	prompt "Default zRAM backend"
	default DEFAULT_ZRAM_ZSMALLOC
	help
	  Select the memory allocator that will be used by default to store
	  compressed pages for all zRAM devices.

	config DEFAULT_ZRAM_ZBUD
		bool "zbud" if ZBUD=y

	config DEFAULT_ZRAM_Z3FOLD
		bool "z3fold" if Z3FOLD=y

	config DEFAULT_ZRAM_ZSMALLOC
		bool "zsmalloc" if ZSMALLOC=y
endchoice

config ZRAM_DEFAULT_BACKEND
	string
	default "zbud" if DEFAULT_ZRAM_ZBUD
	default "z3fold" if DEFAULT_ZRAM_Z3FOLD
	default "zsmalloc"

config ZRAM_SIZE_OVERRIDE
	int "zram size to set from kernel"
	range 1 8
	default 2
```

## drivers/input/fingerprint/fpc_sweet/Kconfig
```kconfig
config FINGERPRINT_FPC_SWEET
	tristate "Finger print card fpc for xiaomi sweet"
	depends on INPUT_FINGERPRINT
	help
	  Say Y here to enable support for retrieving self-test reports.

	  If unsure, say N.

	  To compile this driver as a module, choose M here.
```

## drivers/input/fingerprint/fpc_tee/Kconfig
```kconfig
#
# FPC sensors
#

config FINGERPRINT_FPC_TEE
	tristate "Finger print card fpc"
	depends on INPUT_FINGERPRINT
	help
	  Say Y here to enable support for retrieving self-test reports.

	  If unsure, say N.

	  To compile this driver as a module, choose M here.

config FINGERPRINT_FPC_FOD
	tristate "FPC1020 fingerprint sensor IRQ support"
	depends on INPUT_FINGERPRINT
	help
		If you say yes here you get IRQ support for the FPC1020 family
		of fingerprint sensors from Fingerprint Cards (FPC).
```

## drivers/input/touchscreen/focaltech_touch/Kconfig
```kconfig
#
# Focaltech Touchscreen driver configuration
#

config TOUCHSCREEN_FTS_CAF
	tristate "Focaltech Touchscreen"
	help
	  Say Y here if you have Focaltech touch panel.
	  If unsure, say N.

config TOUCHSCREEN_FTS_DIRECTORY_CAF
	string "Focaltech ts directory name"
	default "focaltech_touch"
	depends on TOUCHSCREEN_FTS_CAF

config FTS_TRUSTED_TOUCH_CAF
	bool "Focaltech Trusted Touch"
	depends on TOUCHSCREEN_FTS_CAF
	help
	  Say Y here to enable Focaltech Trusted Touch.
	  If unsure, say N.

#endif
```
